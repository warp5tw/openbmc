## meta-evb/meta-evb-raspberrypi/meta-rpi3-64/conf/layer.conf
```bitbake
# We have a conf and classes directory, add to BBPATH
BBPATH .= ":${LAYERDIR}"

# We have recipes-* directories, add to BBFILES
BBFILES += "${LAYERDIR}/recipes-*/*/*.bb \
            ${LAYERDIR}/recipes-*/*/*.bbappend"

BBFILE_COLLECTIONS += "rpi3-64-layer"
BBFILE_PATTERN_rpi3-64-layer := "^${LAYERDIR}/"
LAYERSERIES_COMPAT_rpi3-64-layer = "warrior zeus dunfell"
```

## meta-nuvoton/meta-runbmc-buv/conf/layer.conf
```bitbake
# We have a conf and classes directory, add to BBPATH
BBPATH .= ":${LAYERDIR}"

# We have recipes-* directories, add to BBFILES
BBFILES += "${LAYERDIR}/recipes-*/*/*.bb \
            ${LAYERDIR}/recipes-*/*/*.bbappend"

BBFILE_COLLECTIONS += "runbmc-buv-layer"
BBFILE_PATTERN_runbmc-buv-layer := "^${LAYERDIR}/"
LAYERSERIES_COMPAT_runbmc-buv-layer = "warrior zeus"
```

## meta-openbmc-bsp/meta-nuvoton/meta-npcm750/conf/machine/include/npcm750.inc
```bitbake
#@TYPE: Machine
#@NAME: Nuvoton NPCM750
#@DESCRIPTION: Common machine configuration for Nuvoton NPCM750 Chip

PREFERRED_PROVIDER_virtual/kernel ?= "linux-obmc"

KERNEL_IMAGETYPE ?= "uImage"
KERNEL_EXTRA_ARGS ?= "UIMAGE_LOADADDR=0x00008000"
UBOOT_MACHINE ?= "PolegSVB_config"
UBOOT_ENTRYPOINT ?= "0x00200000"
UBOOT_LOADADDRESS ?= "0x00200000"

DEFAULTTUNE = "armv7a"

SERIAL_CONSOLES = "115200;ttyS3"

require conf/machine/include/arm/arch-armv7a.inc
```

## meta-openbmc-bsp/meta-nuvoton/meta-npcm750/recipes-kernel/linux/linux-obmc/defconfig
```kconfig
CONFIG_KERNEL_XZ=y
CONFIG_SYSVIPC=y
CONFIG_BSD_PROCESS_ACCT=y
CONFIG_LOG_BUF_SHIFT=21
CONFIG_CGROUPS=y
CONFIG_SYSFS_DEPRECATED=y
CONFIG_SYSFS_DEPRECATED_V2=y
CONFIG_BLK_DEV_INITRD=y
CONFIG_SYSCTL_SYSCALL=y
CONFIG_EMBEDDED=y
CONFIG_SLAB=y
CONFIG_MODULES=y
CONFIG_MODULE_UNLOAD=y
CONFIG_MODVERSIONS=y
CONFIG_PARTITION_ADVANCED=y
CONFIG_DEFAULT_DEADLINE=y
CONFIG_ARCH_NPCM=y
CONFIG_CPU_NPCM750=y
CONFIG_CPU_NPCM750_SMP=y
CONFIG_MACH_NPCM750=y
CONFIG_VMSPLIT_1G=y
CONFIG_AEABI=y
CONFIG_ZBOOT_ROM_BSS=0x0
CONFIG_CMDLINE="earlyprintk=serial,uart3,115200"
CONFIG_BINFMT_MISC=y
CONFIG_NET=y
CONFIG_PACKET=y
CONFIG_UNIX=y
CONFIG_INET=y
CONFIG_IP_PNP=y
CONFIG_IP_PNP_DHCP=y
CONFIG_IP_PNP_BOOTP=y
CONFIG_UEVENT_HELPER_PATH="/sbin/hotplug"
CONFIG_DEVTMPFS=y
CONFIG_MTD=y
CONFIG_MTD_CMDLINE_PARTS=y
CONFIG_MTD_BLOCK=y
CONFIG_MTD_PARTITIONED_MASTER=y
CONFIG_MTD_RAM=y
CONFIG_MTD_COMPLEX_MAPPINGS=y
CONFIG_MTD_SPI_NOR=y
CONFIG_MTD_UBI=y
CONFIG_MTD_UBI_FASTMAP=y
CONFIG_MTD_UBI_BLOCK=y
CONFIG_OF_OVERLAY=y
CONFIG_BLK_DEV_LOOP=y
CONFIG_BLK_DEV_NBD=y
CONFIG_BLK_DEV_RAM=y
CONFIG_BLK_DEV_RAM_COUNT=1
CONFIG_BLK_DEV_RAM_SIZE=8192
CONFIG_SCSI=y
CONFIG_BLK_DEV_SD=y
CONFIG_NETDEVICES=y
CONFIG_STMMAC_ETH=y
CONFIG_BROADCOM_PHY=y
CONFIG_SERIAL_NPCMX50=y
CONFIG_HW_RANDOM=y
CONFIG_WATCHDOG=y
CONFIG_USB_HIDDEV=y
CONFIG_USB_ANNOUNCE_NEW_DEVICES=y
CONFIG_USB_STORAGE=y
CONFIG_USB_CHIPIDEA=y
CONFIG_USB_CHIPIDEA_UDC=y
CONFIG_USB_GADGET=y
CONFIG_USB_MASS_STORAGE=m
CONFIG_MMC=y
CONFIG_MMC_SDHCI=y
CONFIG_AUTOFS4_FS=y
CONFIG_OVERLAY_FS=y
CONFIG_MSDOS_FS=y
CONFIG_VFAT_FS=y
CONFIG_TMPFS=y
CONFIG_TMPFS_POSIX_ACL=y
CONFIG_JFFS2_FS=y
CONFIG_JFFS2_SUMMARY=y
CONFIG_JFFS2_FS_XATTR=y
CONFIG_UBIFS_FS=y
CONFIG_SQUASHFS=y
CONFIG_SQUASHFS_XZ=y
CONFIG_ROMFS_FS=y
CONFIG_NFS_FS=y
CONFIG_ROOT_NFS=y
CONFIG_CIFS=y
CONFIG_CIFS_XATTR=y
CONFIG_NLS_CODEPAGE_437=y
CONFIG_NLS_ASCII=y
CONFIG_NLS_ISO8859_1=y
CONFIG_DEBUG_SECTION_MISMATCH=y
CONFIG_MAGIC_SYSRQ=y
CONFIG_FUNCTION_TRACER=y
CONFIG_DEBUG_LL=y
CONFIG_DEBUG_UART_VIRT=0xf0004000
CONFIG_EARLY_PRINTK=y
CONFIG_CRYPTO_CBC=y
CONFIG_CRYPTO_CTR=y
CONFIG_CRYPTO_CMAC=y
CONFIG_CRYPTO_CRC32C=y
CONFIG_CRYPTO_SHA1=y
CONFIG_CRYPTO_USER_API_SKCIPHER=y
CONFIG_ARM_CRYPTO=y
```

## meta-openbmc-machines/meta-evb/meta-evb-nuvoton/meta-evb-npcm750/conf/machine/evb-npcm750.conf
```bitbake
KMACHINE = "nuvoton"
KERNEL_DEVICETREE = "nuvoton-npcm750-evb.dtb"

UBOOT_MACHINE = "PolegSVB_config"

FLASH_SIZE = "32768"

require conf/machine/include/npcm7xx.inc
require conf/machine/include/obmc-bsp-common.inc
```
